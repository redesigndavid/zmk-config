## config/west.yml
```yaml
manifest:
  remotes:
    - name: zmkfirmware
      url-base: https://github.com/zmkfirmware
  projects:
    - name: zmk
      remote: nickconway
      revision: dynamic-macro
      import: app/west.yml
  self:
    path: config
```
